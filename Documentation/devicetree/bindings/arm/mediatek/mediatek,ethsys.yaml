## Documentation/devicetree/bindings/arm/mediatek/mediatek,ethsys.yaml
```yaml
# SPDX-License-Identifier: (GPL-2.0 OR BSD-2-Clause)
%YAML 1.2
---
$id: "http://devicetree.org/schemas/arm/mediatek/mediatek,ethsys.yaml#"
$schema: "http://devicetree.org/meta-schemas/core.yaml#"

title: MediaTek Ethsys controller

maintainers:
  - Lorenzo Bianconi <lorenzo@kernel.org>

description:
  The Mediatek Ethsys controller provides various clocks to the system.
  The ethsys controller relies on the common clk binding. The available
  clocks are defined in dt-bindings/clock/mt*-clk.h.

properties:
  compatible:
    items:
      - enum:
          - mediatek,mt2701-ethsys
          - mediatek,mt7622-ethsys
          - mediatek,mt7623-ethsys
          - mediatek,mt7629-ethsys
          - mediatek,mt7986-ethsys
      - const: syscon

  reg:
    maxItems: 1

  "#clock-cells":
    const: 1

  "#reset-cells":
    const: 1

required:
  - compatible
  - reg
  - "#clock-cells"
  - "#reset-cells"

additionalProperties: false

examples:
  - |
    soc {
      #address-cells = <2>;
      #size-cells = <2>;

      ethsys: clock-controller@1b000000 {
        compatible = "mediatek,mt2701-ethsys","syscon";
        reg = <0 0x1b000000 0 0x1000>;
        #clock-cells = <1>;
        #reset-cells = <1>;
      };
    };
```

## Documentation/devicetree/bindings/arm/mediatek/mediatek,mt7622-wed.yaml
```yaml
# SPDX-License-Identifier: (GPL-2.0 OR BSD-2-Clause)
%YAML 1.2
---
$id: "http://devicetree.org/schemas/arm/mediatek/mediatek,mt7622-wed.yaml#"
$schema: "http://devicetree.org/meta-schemas/core.yaml#"

title: MediaTek Wireless Ethernet Dispatch Controller for MT7622

maintainers:
  - Lorenzo Bianconi <lorenzo@kernel.org>
  - Felix Fietkau <nbd@nbd.name>

description:
  The mediatek wireless ethernet dispatch controller can be configured to
  intercept and handle access to the WLAN DMA queues and PCIe interrupts
  and implement hardware flow offloading from ethernet to WLAN.

properties:
  compatible:
    items:
      - enum:
          - mediatek,mt7622-wed
          - mediatek,mt7986-wed
      - const: syscon

  reg:
    maxItems: 1

  interrupts:
    maxItems: 1

  memory-region:
    items:
      - description: firmware EMI region
      - description: firmware DLM region
      - description: firmware CPU DATA region

  memory-region-names:
    items:
      - const: wo-emi
      - const: wo-dlm
      - const: wo-data

  mediatek,wo-ccif:
    $ref: /schemas/types.yaml#/definitions/phandle
    description: mediatek wed-wo controller interface.

  mediatek,wo-cpuboot:
    $ref: /schemas/types.yaml#/definitions/phandle
    description: mediatek wed-wo cpuboot controller interface.

  mediatek,wo-ilm:
    $ref: /schemas/types.yaml#/definitions/phandle
    description: mediatek wed-wo ilm interface.

allOf:
  - if:
      properties:
        compatible:
          contains:
            const: mediatek,mt7622-wed
    then:
      properties:
        memory-region-names: false
        memory-region: false
        mediatek,wo-ccif: false
        mediatek,wo-cpuboot: false
        mediatek,wo-ilm: false

required:
  - compatible
  - reg
  - interrupts

additionalProperties: false

examples:
  - |
    #include <dt-bindings/interrupt-controller/arm-gic.h>
    #include <dt-bindings/interrupt-controller/irq.h>
    soc {
      #address-cells = <2>;
      #size-cells = <2>;
      wed0: wed@1020a000 {
        compatible = "mediatek,mt7622-wed","syscon";
        reg = <0 0x1020a000 0 0x1000>;
        interrupts = <GIC_SPI 214 IRQ_TYPE_LEVEL_LOW>;
      };
    };

  - |
    #include <dt-bindings/interrupt-controller/arm-gic.h>
    #include <dt-bindings/interrupt-controller/irq.h>
    soc {
      #address-cells = <2>;
      #size-cells = <2>;

      wed@15010000 {
        compatible = "mediatek,mt7986-wed", "syscon";
        reg = <0 0x15010000 0 0x1000>;
        interrupts = <GIC_SPI 205 IRQ_TYPE_LEVEL_HIGH>;

        memory-region = <&wo_emi>, <&wo_dlm>, &wo_data>;
        memory-region-names = "wo-emi", "wo-dlm", "wo-data";
        mediatek,wo-ccif = <&wo_ccif0>;
        mediatek,wo-cpuboot = <&wo_cpuboot>;
        mediatek,wo-ilm = <&wo_ilm>;
      };
    };
```

## Documentation/devicetree/bindings/arm/mediatek/mediatek,mt7986-wo-boot.yaml
```yaml
# SPDX-License-Identifier: (GPL-2.0 OR BSD-2-Clause)
%YAML 1.2
---
$id: http://devicetree.org/schemas/arm/mediatek/mediatek,mt7986-wo-boot.yaml#
$schema: http://devicetree.org/meta-schemas/core.yaml#

title:
  MediaTek Wireless Ethernet Dispatch WO boot controller interface for MT7986

maintainers:
  - Lorenzo Bianconi <lorenzo@kernel.org>
  - Felix Fietkau <nbd@nbd.name>

description:
  The mediatek wo-boot provides a configuration interface for WED WO
  boot controller on MT7986 soc.

properties:
  compatible:
    items:
      - enum:
          - mediatek,mt7986-wo-boot
      - const: syscon

  reg:
    maxItems: 1

  interrupts:
    maxItems: 1

required:
  - compatible
  - reg

additionalProperties: false

examples:
  - |
    soc {
      #address-cells = <2>;
      #size-cells = <2>;

      wo_boot: syscon@15194000 {
        compatible = "mediatek,mt7986-wo-boot", "syscon";
        reg = <0 0x15194000 0 0x1000>;
      };
    };
```

## Documentation/devicetree/bindings/arm/mediatek/mediatek,mt7986-wo-ccif.yaml
```yaml
# SPDX-License-Identifier: (GPL-2.0 OR BSD-2-Clause)
%YAML 1.2
---
$id: http://devicetree.org/schemas/arm/mediatek/mediatek,mt7986-wo-ccif.yaml#
$schema: http://devicetree.org/meta-schemas/core.yaml#

title: MediaTek Wireless Ethernet Dispatch WO controller interface for MT7986

maintainers:
  - Lorenzo Bianconi <lorenzo@kernel.org>
  - Felix Fietkau <nbd@nbd.name>

description:
  The mediatek wo-ccif provides a configuration interface for WED WO
  controller on MT7986 soc.

properties:
  compatible:
    items:
      - enum:
          - mediatek,mt7986-wo-ccif
      - const: syscon

  reg:
    maxItems: 1

  interrupts:
    maxItems: 1

required:
  - compatible
  - reg
  - interrupts

additionalProperties: false

examples:
  - |
    #include <dt-bindings/interrupt-controller/arm-gic.h>
    #include <dt-bindings/interrupt-controller/irq.h>
    soc {
      #address-cells = <2>;
      #size-cells = <2>;

      wo_ccif0: syscon@151a5000 {
        compatible = "mediatek,mt7986-wo-ccif", "syscon";
        reg = <0 0x151a5000 0 0x1000>;
        interrupts = <GIC_SPI 205 IRQ_TYPE_LEVEL_HIGH>;
      };
    };
```

## Documentation/devicetree/bindings/arm/mediatek/mediatek,mt7986-wo-dlm.yaml
```yaml
# SPDX-License-Identifier: (GPL-2.0 OR BSD-2-Clause)
%YAML 1.2
---
$id: http://devicetree.org/schemas/arm/mediatek/mediatek,mt7986-wo-dlm.yaml#
$schema: http://devicetree.org/meta-schemas/core.yaml#

title: MediaTek Wireless Ethernet Dispatch WO hw rx ring interface for MT7986

maintainers:
  - Lorenzo Bianconi <lorenzo@kernel.org>
  - Felix Fietkau <nbd@nbd.name>

description:
  The mediatek wo-dlm provides a configuration interface for WED WO
  rx ring on MT7986 soc.

properties:
  compatible:
    const: mediatek,mt7986-wo-dlm

  reg:
    maxItems: 1

  resets:
    maxItems: 1

  reset-names:
    maxItems: 1

required:
  - compatible
  - reg
  - resets
  - reset-names

additionalProperties: false

examples:
  - |
    soc {
      #address-cells = <2>;
      #size-cells = <2>;

      wo_dlm0: wo-dlm@151e8000 {
        compatible = "mediatek,mt7986-wo-dlm";
        reg = <0 0x151e8000 0 0x2000>;
        resets = <&ethsysrst 0>;
        reset-names = "wocpu_rst";
      };
    };
```

## Documentation/devicetree/bindings/soc/mediatek/mediatek,mt7986-wo-cpuboot.yaml
```yaml
# SPDX-License-Identifier: (GPL-2.0 OR BSD-2-Clause)
%YAML 1.2
---
$id: http://devicetree.org/schemas/soc/mediatek/mediatek,mt7986-wo-cpuboot.yaml#
$schema: http://devicetree.org/meta-schemas/core.yaml#

title: MediaTek Wireless Ethernet Dispatch (WED) WO Boot firmware interface for MT7986

maintainers:
  - Lorenzo Bianconi <lorenzo@kernel.org>
  - Felix Fietkau <nbd@nbd.name>

description:
  The MediaTek wo-cpuboot provides a configuration interface for WED WO
  controller boot firmware. WED is used to perform offload rx packet
  processing (e.g. 802.11 aggregation packet reordering or rx header
  translation) on MT7986 soc.

properties:
  compatible:
    items:
      - enum:
          - mediatek,mt7986-wo-cpuboot
      - const: syscon

  reg:
    maxItems: 1

required:
  - compatible
  - reg

additionalProperties: false

examples:
  - |
    soc {
      #address-cells = <2>;
      #size-cells = <2>;

      syscon@15194000 {
        compatible = "mediatek,mt7986-wo-cpuboot", "syscon";
        reg = <0 0x15194000 0 0x1000>;
      };
    };
```

## Documentation/devicetree/bindings/soc/mediatek/mediatek,mt7986-wo-dlm.yaml
```yaml
# SPDX-License-Identifier: (GPL-2.0 OR BSD-2-Clause)
%YAML 1.2
---
$id: http://devicetree.org/schemas/soc/mediatek/mediatek,mt7986-wo-dlm.yaml#
$schema: http://devicetree.org/meta-schemas/core.yaml#

title: MediaTek Wireless Ethernet Dispatch (WED) WO DLM firmware interface for MT7986

maintainers:
  - Lorenzo Bianconi <lorenzo@kernel.org>
  - Felix Fietkau <nbd@nbd.name>

description:
  The MediaTek wo-dlm (Data Lifecycle Management) provides a configuration
  interface for WED WO firmware rx rings, including firmware I/O descriptor
  ring, feedback command ring. WED WO controller is used to perform offload
  rx packet processing (e.g. 802.11 aggregation packet reordering or rx
  header translation) on MT7986 soc.

properties:
  compatible:
    items:
      - enum:
          - mediatek,mt7986-wo-dlm
      - const: syscon

  reg:
    maxItems: 1

required:
  - compatible
  - reg

additionalProperties: false

examples:
  - |
    soc {
      #address-cells = <2>;
      #size-cells = <2>;

      syscon@151e8000 {
        compatible = "mediatek,mt7986-wo-dlm", "syscon";
        reg = <0 0x151e8000 0 0x2000>;
      };
    };
```

## Documentation/devicetree/bindings/soc/mediatek/mediatek,mt7986-wo-ilm.yaml
```yaml
# SPDX-License-Identifier: (GPL-2.0 OR BSD-2-Clause)
%YAML 1.2
---
$id: http://devicetree.org/schemas/soc/mediatek/mediatek,mt7986-wo-ilm.yaml#
$schema: http://devicetree.org/meta-schemas/core.yaml#

title: MediaTek Wireless Ethernet Dispatch (WED) WO ILM firmware interface for MT7986

maintainers:
  - Lorenzo Bianconi <lorenzo@kernel.org>
  - Felix Fietkau <nbd@nbd.name>

description:
  The MediaTek wo-ilm (Information Lifecycle Management) provides a configuration
  interface for WiFi critical data used by WED WO firmware. WED WO controller is
  used to perform offload rx packet processing (e.g. 802.11 aggregation packet
  reordering or rx header translation) on MT7986 soc.

properties:
  compatible:
    items:
      - enum:
          - mediatek,mt7986-wo-ilm
      - const: syscon

  reg:
    maxItems: 1

required:
  - compatible
  - reg

additionalProperties: false

examples:
  - |
    soc {
      #address-cells = <2>;
      #size-cells = <2>;

      syscon@151e0000 {
        compatible = "mediatek,mt7986-wo-ilm", "syscon";
        reg = <0 0x151e0000 0 0x8000>;
      };
    };
```
